#include "esc_hw5.h"

#include <stdio.h>

#include "auto_offset.h"
#include "cell_count.h"
#include "pico/stdlib.h"
#include "uart.h"
#include "uart_pio.h"

#define TIMEOUT_US 2000
#define PACKET_LENGHT 32

static uint8_t *CRCH_, *CRCL_;
static void process(esc_hw5_parameters_t *parameter);
static uint16_t calculate_crc16(uint8_t const *buffer, uint lenght);

void esc_hw5_task(void *parameters) {
    esc_hw5_parameters_t parameter = *(esc_hw5_parameters_t *)parameters;
    *parameter.rpm = 0;
    *parameter.voltage = 0;
    *parameter.current = 0;
    *parameter.temperature_fet = 0;
    *parameter.temperature_bec = 0;
    *parameter.temperature_motor = 0;
    *parameter.voltage_bec = 0;
    *parameter.current_bec = 0;
    *parameter.cell_voltage = 0;
    *parameter.consumption = 0;
    *parameter.cell_count = 1;
    xTaskNotifyGive(context.receiver_task_handle);
    uint8_t CRCH[] = {0x00, 0xC1, 0x81, 0x40, 0x01, 0xC0, 0x80, 0x41, 0x01, 0xC0, 0x80, 0x41, 0x00, 0xC1, 0x81, 0x40,
                      0x01, 0xC0, 0x80, 0x41, 0x00, 0xC1, 0x81, 0x40, 0x00, 0xC1, 0x81, 0x40, 0x01, 0xC0, 0x80, 0x41,
                      0x01, 0xC0, 0x80, 0x41, 0x00, 0xC1, 0x81, 0x40, 0x00, 0xC1, 0x81, 0x40, 0x01, 0xC0, 0x80, 0x41,
                      0x00, 0xC1, 0x81, 0x40, 0x01, 0xC0, 0x80, 0x41, 0x01, 0xC0, 0x80, 0x41, 0x00, 0xC1, 0x81, 0x40,
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                      0x00, 0xC1, 0x81, 0x40, 0x01, 0xC0, 0x80, 0x41, 0x01, 0xC0, 0x80, 0x41, 0x00, 0xC1, 0x81, 0x40};
    uint8_t CRCL[] = {0x00, 0xC0, 0xC1, 0x01, 0xC3, 0x03, 0x02, 0xC2, 0xC6, 0x06, 0x07, 0xC7, 0x05, 0xC5, 0xC4, 0x04,
                      0xCC, 0x0C, 0x0D, 0xCD, 0x0F, 0xCF, 0xCE, 0x0E, 0x0A, 0xCA, 0xCB, 0x0B, 0xC9, 0x09, 0x08, 0xC8,
                      0xD8, 0x18, 0x19, 0xD9, 0x1B, 0xDB, 0xDA, 0x1A, 0x1E, 0xDE, 0xDF, 0x1F, 0xDD, 0x1D, 0x1C, 0xDC,
                      0x14, 0xD4, 0xD5, 0x15, 0xD7, 0x17, 0x16, 0xD6, 0xD2, 0x12, 0x13, 0xD3, 0x11, 0xD1, 0xD0, 0x10,
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                      0x44, 0x84, 0x85, 0x45, 0x87, 0x47, 0x46, 0x86, 0x82, 0x42, 0x43, 0x83, 0x41, 0x81, 0x80, 0x40};
    CRCL_ = CRCL;
    CRCH_ = CRCH;
#ifdef SIM_SENSORS
    *parameter.rpm = 12345.67;
    *parameter.consumption = 123.4;
    *parameter.voltage = 12.34;
    *parameter.current = 5.678;
    *parameter.temperature_fet = 12.34;
    *parameter.temperature_bec = 23.45;
    *parameter.cell_voltage = 3.75;
#endif

    TaskHandle_t task_handle;
    uint cell_count_delay = 15000;
    cell_count_parameters_t cell_count_parameters = {cell_count_delay, parameter.voltage, parameter.cell_count};
    xTaskCreate(cell_count_task, "cell_count_task", STACK_CELL_COUNT, (void *)&cell_count_parameters, 1, &task_handle);
    xQueueSendToBack(context.tasks_queue_handle, task_handle, 0);

    uart1_begin(115200, UART1_TX_GPIO, UART_ESC_RX, TIMEOUT_US, 8, 1, UART_PARITY_NONE, false);

    while (1) {
        ulTaskNotifyTakeIndexed(1, pdTRUE, portMAX_DELAY);
        process(&parameter);
    }
}

static void process(esc_hw5_parameters_t *parameter) {
    static uint32_t timestamp = 0;
    uint8_t lenght = uart1_available();
    if (lenght) {
        uint8_t data[lenght];
        uart1_read_bytes(data, lenght);
        if (lenght == PACKET_LENGHT) {
            uint16_t packet_crc = (data[31] << 8) | data[30];
            uint16_t crc = calculate_crc16(data, PACKET_LENGHT - 2);
            if (crc == packet_crc) {
                uint16_t throttle;
                throttle = data[7 + 2];
                *parameter->rpm = (data[7 + 6] | (data[7 + 7] << 8)) * 10 * parameter->rpm_multiplier;
                *parameter->voltage = (data[7 + 8] | (data[7 + 9] << 8)) / 10.0;
                *parameter->current = (data[7 + 10] | (data[7 + 11] << 8)) / 10.0;
                if (data[7 + 12] != 0xFF) *parameter->temperature_fet = data[7 + 12];
                if (data[7 + 13] != 0xFF) *parameter->temperature_bec = data[7 + 13];
                if (data[7 + 14] != 0xFF) *parameter->temperature_motor = data[7 + 14];
                if (data[7 + 15] != 0xFF) *parameter->voltage_bec = data[7 + 15];
                if (data[7 + 16] != 0xFF) *parameter->current_bec = data[7 + 16];
                *parameter->cell_voltage = *parameter->voltage / *parameter->cell_count;
                *parameter->consumption += get_consumption(*parameter->current, 0, &timestamp);

                debug(
                    "\nEsc VBAR (%u) < Rpm: %.0f Volt: %0.2f Curr: %.2f TempFet: %.0f TempBec: %.0f TempMotor: %.0f "
                    "Vbec: %.1f Cbec: %.1f Cons: %.0f CellCount: %u CellV: %.2f",
                    uxTaskGetStackHighWaterMark(NULL), *parameter->rpm, *parameter->voltage, *parameter->current,
                    *parameter->temperature_fet, *parameter->temperature_bec, *parameter->temperature_motor,
                    *parameter->voltage_bec, *parameter->current_bec, *parameter->consumption, *parameter->cell_count,
                    *parameter->cell_voltage, *parameter->cell_voltage);
            }
            debug("\nEsc VBAR CRC error (%u): ", uxTaskGetStackHighWaterMark(NULL));
            debug_buffer(data, lenght, "0x%X ");
            debug("\nCalculated CRC: ", crc);
        } else {
            debug("\nEsc VBAR packet error (%u): ", uxTaskGetStackHighWaterMark(NULL));
            debug_buffer(data, lenght, "0x%X ");
        }
    }
}

static uint16_t calculate_crc16(uint8_t const *buffer, uint lenght) {
    // CRC16-MODBUS
    // 8005(x16+x15+x2+1)
    uint8_t crc_high = 0xFF;
    uint8_t crc_low = 0xFF;
    uint8_t index;
    while (lenght--) {
        index = crc_low ^ (*(buffer++));
        crc_low = crc_high ^ CRCH_[index];
        crc_high = CRCL_[index];
    }
    return (uint16_t)((uint16_t)(crc_high << 8) | crc_low);
}
